/* Overlay per portare il SYSCLK a 216 MHz su Nucleo-F746ZG */

&pll {
    /* HSE = 8 MHz
     * VCO = 8 / 8 * 432 = 432 MHz
     * SYSCLK = 432 / 2 = 216 MHz
     */
    div-m = <8>;
    mul-n = <432>;
    div-p = <2>;
    div-q = <9>;  /* Per USB/SDIO 48 MHz */
    clocks = <&clk_hse>;
    status = "okay";
};

&rcc {
    clocks = <&pll>;
    clock-frequency = <DT_FREQ_M(216)>;

    ahb-prescaler  = <1>;  /* 216 MHz */
    apb1-prescaler = <4>;  /* 54 MHz */
    apb2-prescaler = <2>;  /* 108 MHz */
};

/* Disabilita periferiche non usate (modifica secondo necessità) */
&spi1 {
    status = "disabled";
};

&timers2 {
    status = "disabled";
};

/* Verificare se pwm2 esiste, altrimenti rimuovere o sostituire */
