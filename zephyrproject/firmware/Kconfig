## zephyrproject/firmware/Kconfig
```kconfig
source "Kconfig.zephyr"

menu "WAMR"
config WAMR_GLOBAL_POOL_SIZE
    int "WAMR global pool size (bytes)"
    default 65536
help
  Size of the global WAMR heap pool used by Alloc_With_Pool.
endmenu
```

## zephyrproject/firmware/build_f746zg/Kconfig/boards/Kconfig.nucleo_f746zg
```kconfig
# Load board Kconfig descriptions.
osource "C:/Users/Salvo/stm32-wasm-runtime-benchmarks/zephyrproject/zephyr/boards/st/nucleo_f746zg/Kconfig.nucleo_f746zg"
```

## zephyrproject/firmware/build_nrf52840dk_nrf52840/Kconfig/boards/Kconfig
```kconfig
# Load Zephyr board Kconfig descriptions.
osource "C:/Users/Salvo/stm32-wasm-runtime-benchmarks/zephyrproject/zephyr/boards/nordic/nrf52840dk/Kconfig"
```

## zephyrproject/firmware/build_nrf52840dk_nrf52840/Kconfig/boards/Kconfig.defconfig
```kconfig
# Load Zephyr board defconfig descriptions.
osource "C:/Users/Salvo/stm32-wasm-runtime-benchmarks/zephyrproject/zephyr/boards/nordic/nrf52840dk/Kconfig.defconfig"
```

## zephyrproject/firmware_2/build_litex_vexriscv/Kconfig/boards/Kconfig
```kconfig
# Load Zephyr board Kconfig descriptions.
osource "C:/Users/Salvo/stm32-wasm-runtime-benchmarks/zephyrproject/zephyr/boards/enjoydigital/litex_vexriscv/Kconfig"
```

## zephyrproject/firmware_2/build_litex_vexriscv/Kconfig/boards/Kconfig.defconfig
```kconfig
# Load Zephyr board defconfig descriptions.
osource "C:/Users/Salvo/stm32-wasm-runtime-benchmarks/zephyrproject/zephyr/boards/enjoydigital/litex_vexriscv/Kconfig.defconfig"
```
