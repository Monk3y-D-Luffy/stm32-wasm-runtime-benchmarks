## prj.conf
```kconfig
CONFIG_UART_CONSOLE=y
CONFIG_CONSOLE=y
CONFIG_PRINTK=y

CONFIG_LOG=n

CONFIG_ASSERT=n
CONFIG_DEBUG=n
CONFIG_DEBUG_OPTIMIZATIONS=n
CONFIG_NO_OPTIMIZATIONS=n

# Ottimizza per la velocità (-O2)
CONFIG_SPEED_OPTIMIZATIONS=y

# FPU hardware (per ARM M4F)
CONFIG_FPU=y
```

## src/main.c
```c
#include <stm32f4xx.h>
#include <stdlib.h>
#include <string.h>

#include <zephyr/kernel.h>

#include "bh_platform.h"
#include "bh_assert.h"
#include "bh_log.h"
#include "wasm_export.h"

#include "fft_bench_aot.h"   // generato da xxd -i

/* Config WAMR */
#define CONFIG_GLOBAL_HEAP_BUF_SIZE WASM_GLOBAL_HEAP_SIZE
#define CONFIG_APP_STACK_SIZE       8192
#define CONFIG_APP_HEAP_SIZE        8192
#define CONFIG_MAIN_THREAD_STACK_SIZE 8192

#define NUM_ITER  100

static int app_argc;
static char **app_argv;

/* Risultati benchmark */
static volatile uint32_t total_cycles = 0;
static volatile uint32_t avg_cycles   = 0;

/* ===== DWT cycle counter ===== */
static void DWT_Init(void)
{
    CoreDebug->DEMCR |= CoreDebug_DEMCR_TRCENA_Msk; // abilita DWT
    DWT->CYCCNT = 0;
    DWT->CTRL |= DWT_CTRL_CYCCNTENA_Msk;
}

/* ===== Esegue init_buffer + bench(NUM_ITER) nel modulo Wasm e misura i cicli ===== */
static void
run_fft_bench(wasm_module_inst_t module_inst)
{
    const char *exception;
    wasm_function_inst_t fn_init = NULL;
    wasm_function_inst_t fn_bench = NULL;
    wasm_exec_env_t exec_env = NULL;
    uint32 argv[1];

    /* lookup funzioni esportate */
    fn_init = wasm_runtime_lookup_function(module_inst, "fft_init");
    if (!fn_init) {
        printk("Failed to find init_buffer\n");
        return;
    }

    fn_bench = wasm_runtime_lookup_function(module_inst, "fft_bench");
    if (!fn_bench) {
        printk("Failed to find bench\n");
        return;
    }

    /* crea execution env per il modulo */
    exec_env = wasm_runtime_create_exec_env(module_inst, CONFIG_APP_STACK_SIZE);
    if (!exec_env) {
        printk("Create exec env failed\n");
        return;
    }

    /* inizializza il buffer lato Wasm (non misurato) */
    if (!wasm_runtime_call_wasm(exec_env, fn_init, 0, NULL)) {
        exception = wasm_runtime_get_exception(module_inst);
        printk("Exception in init_buffer: %s\n", exception ? exception : "<none>");
        goto out;
    }

    /* prepara DWT e disabilita SysTick/IRQ per una misura comparabile agli altri test */
    DWT_Init();
    SysTick->CTRL = 0;       /* disabilita SysTick */
    __disable_irq();

    uint32_t start = DWT->CYCCNT;

    /* bench(NUM_ITER) */
    argv[0] = (uint32)NUM_ITER;
    if (!wasm_runtime_call_wasm(exec_env, fn_bench, 1, argv)) {
        __enable_irq();
        exception = wasm_runtime_get_exception(module_inst);
        printk("Exception in bench: %s\n", exception ? exception : "<none>");
        goto out;
    }

    uint32_t end = DWT->CYCCNT;

    __enable_irq();

    total_cycles = end - start;
    avg_cycles   = total_cycles / NUM_ITER;

    printk("Zephyr + WAMR(AOT)\n");
    printk("Total cycles: %lu\n", (unsigned long)total_cycles);
    printk("Avg cycles per FFT: %lu\n", (unsigned long)avg_cycles);

out:
    wasm_runtime_destroy_exec_env(exec_env);
}


/* ===== Thread che inizializza WAMR e lancia il benchmark ===== */
void
iwasm_main(void *arg1, void *arg2, void *arg3)
{
    (void)arg1;
    (void)arg2;
    (void)arg3;

    uint8 *wasm_file_buf;
    uint32 wasm_file_size;
    wasm_module_t wasm_module = NULL;
    wasm_module_inst_t wasm_module_inst = NULL;
    RuntimeInitArgs init_args;
    char error_buf[128];

#if WASM_ENABLE_LOG != 0
    int log_verbose_level = 0; /* 0 per non sporcare la misura */
#endif

memset(&init_args, 0, sizeof(RuntimeInitArgs));

init_args.mem_alloc_type = Alloc_With_System_Allocator;

    /* nessun modulo nativo necessario per fft_bench.wasm */
    init_args.native_module_name  = NULL;
    init_args.native_symbols      = NULL;
    init_args.n_native_symbols    = 0;

    if (!wasm_runtime_full_init(&init_args)) {
        printk("Init runtime failed\n");
        return;
    }

#if WASM_ENABLE_LOG != 0
    bh_log_set_verbose_level(log_verbose_level);
#endif

    /* usa il blob incluso fft_bench.wasm */
    wasm_file_buf  = (uint8 *)fft_bench_aot;
    wasm_file_size = (uint32)fft_bench_aot_len;

    if (!(wasm_module = wasm_runtime_load(wasm_file_buf, wasm_file_size,
                                          error_buf, sizeof(error_buf)))) {
        printk("Load module failed: %s\n", error_buf);
        goto fail1;
    }

    if (!(wasm_module_inst = wasm_runtime_instantiate(
              wasm_module, CONFIG_APP_STACK_SIZE, CONFIG_APP_HEAP_SIZE,
              error_buf, sizeof(error_buf)))) {
        printk("Instantiate failed: %s\n", error_buf);
        goto fail2;
    }

    /* esegue il benchmark FFT-like */
    run_fft_bench(wasm_module_inst);

    wasm_runtime_deinstantiate(wasm_module_inst);

fail2:
    wasm_runtime_unload(wasm_module);

fail1:
    wasm_runtime_destroy();

    /* puoi mettere un loop vuoto per fermare il thread */
    while (1) {
        k_sleep(K_FOREVER);
    }
}

/* ===== Creazione thread WAMR ===== */
#define MAIN_THREAD_STACK_SIZE (CONFIG_MAIN_THREAD_STACK_SIZE)
#define MAIN_THREAD_PRIORITY   5

K_THREAD_STACK_DEFINE(iwasm_main_thread_stack, MAIN_THREAD_STACK_SIZE);
static struct k_thread iwasm_main_thread;

bool
iwasm_init(void)
{
    k_tid_t tid = k_thread_create(
        &iwasm_main_thread,
        iwasm_main_thread_stack,
        MAIN_THREAD_STACK_SIZE,
        iwasm_main,
        NULL, NULL, NULL,
        MAIN_THREAD_PRIORITY,
        0,
        K_NO_WAIT);

    return tid ? true : false;
}

/* ===== Entry Zephyr ===== */
void
main(void)
{
    /* qui niente GPIO toggle, solo benchmark WAMR */
    (void)iwasm_init();
    /* main può dormire, il lavoro lo fa il thread iwasm_main */
    while (1) {
        k_sleep(K_FOREVER);
    }
}
```

## src/fft_bench_aot.h
```c
unsigned char fft_bench_aot[] = {
  0x00, 0x61, 0x6f, 0x74, 0x05, 0x00, 0x00, 0x00, 0x00, 0x00, 0x00, 0x00,
  0x30, 0x00, 0x00, 0x00, 0x00, 0x00, 0x00, 0x00, 0x01, 0x00, 0x28, 0x00,
  0x01, 0x00, 0x00, 0x00, 0x00, 0x00, 0x00, 0x05, 0x00, 0x00, 0x00, 0x00,
  0x00, 0x00, 0x00, 0x00, 0x00, 0x00, 0x00, 0x00, 0x00, 0x00, 0x00, 0x00,
  0x74, 0x68, 0x75, 0x6d, 0x62, 0x76, 0x37, 0x65, 0x6d, 0x00, 0x00, 0x00,
  0x00, 0x00, 0x00, 0x00, 0x01, 0x00, 0x00, 0x00, 0xcc, 0x00, 0x00, 0x00,
  0x00, 0x00, 0x00, 0x00, 0x01, 0x00, 0x00, 0x00, 0x00, 0x00, 0x00, 0x00,
  0x00, 0x00, 0x01, 0x00, 0x01, 0x00, 0x00, 0x00, 0x01, 0x00, 0x00, 0x00,
  0x00, 0x00, 0x00, 0x00, 0x00, 0x00, 0x00, 0x00, 0x01, 0x00, 0x00, 0x00,
  0x70, 0x01, 0x00, 0x00, 0x01, 0x00, 0x00, 0x00, 0x01, 0x00, 0x00, 0x00,
  0x00, 0x00, 0x00, 0x00, 0x04, 0x00, 0x00, 0x00, 0x00, 0x00, 0x00, 0x00,
  0x00, 0x00, 0x00, 0x00, 0x00, 0x00, 0x01, 0x00, 0x00, 0x00, 0x7f, 0x00,
  0x00, 0x00, 0x00, 0x00, 0x01, 0x00, 0x7d, 0x00, 0x00, 0x00, 0x00, 0x00,
  0x01, 0x00, 0x7f, 0x00, 0x00, 0x00, 0x00, 0x00, 0x01, 0x00, 0x00, 0x00,
  0x7f, 0x01, 0x00, 0x00, 0x41, 0x00, 0x00, 0x00, 0x10, 0x64, 0x00, 0x00,
  0x00, 0x00, 0x00, 0x00, 0x04, 0x00, 0x00, 0x00, 0xff, 0xff, 0xff, 0xff,
  0xff, 0xff, 0xff, 0xff, 0x00, 0x00, 0x00, 0x00, 0x00, 0x00, 0x00, 0x00,
  0xff, 0xff, 0xff, 0xff, 0x00, 0x00, 0x00, 0x00, 0x00, 0x00, 0x00, 0x00,
  0xff, 0xff, 0xff, 0xff, 0x00, 0x00, 0x00, 0x00, 0x00, 0x00, 0x00, 0x00,
  0x00, 0x00, 0x00, 0x00, 0x01, 0x00, 0x00, 0x00, 0x11, 0x00, 0x2e, 0x61,
  0x6f, 0x74, 0x5f, 0x73, 0x74, 0x61, 0x63, 0x6b, 0x5f, 0x73, 0x69, 0x7a,
  0x65, 0x73, 0x00, 0x00, 0x10, 0x00, 0x00, 0x00, 0x48, 0x00, 0x00, 0x00,
  0x64, 0x00, 0x00, 0x00, 0x18, 0x00, 0x00, 0x00, 0x00, 0x00, 0x00, 0x00,
  0x02, 0x00, 0x00, 0x00, 0x78, 0x02, 0x00, 0x00, 0x00, 0x00, 0x00, 0x00,
  0x80, 0xb5, 0x82, 0xb0, 0x01, 0x46, 0x40, 0xf2, 0x00, 0x00, 0xc0, 0xf2,
  0x00, 0x00, 0x01, 0xab, 0x02, 0x68, 0x88, 0x68, 0x93, 0x42, 0x22, 0xbf,
  0x9a, 0x1a, 0x09, 0x69, 0x8a, 0x42, 0x04, 0xd2, 0x0b, 0x21, 0xff, 0xf7,
  0xfe, 0xff, 0x02, 0xb0, 0x80, 0xbd, 0x02, 0xb0, 0xbd, 0xe8, 0x80, 0x40,
  0xff, 0xe7, 0x2d, 0xe9, 0xf0, 0x4f, 0x83, 0xb0, 0xd0, 0xf8, 0x78, 0x11,
  0x4f, 0xf0, 0x00, 0x09, 0xd0, 0xf8, 0xb8, 0xa1, 0x00, 0x25, 0xcd, 0xe9,
  0x01, 0x01, 0x28, 0x46, 0x09, 0xf5, 0x80, 0x64, 0xff, 0xf7, 0xfe, 0xff,
  0x54, 0x45, 0x9f, 0xbf, 0x06, 0x46, 0x02, 0x98, 0x00, 0xeb, 0x09, 0x07,
  0xc7, 0xf8, 0x00, 0x64, 0x9c, 0xbf, 0x04, 0xf1, 0x08, 0x08, 0xd0, 0x45,
  0x21, 0xd8, 0x01, 0x35, 0x28, 0x46, 0xff, 0xf7, 0xfe, 0xff, 0x83, 0x46,
  0xc7, 0xf8, 0x08, 0x04, 0x30, 0x46, 0x4f, 0xf0, 0x7c, 0x51, 0xff, 0xf7,
  0xfe, 0xff, 0xc7, 0xf8, 0x04, 0x04, 0x58, 0x46, 0x4f, 0xf0, 0x7c, 0x51,
  0xff, 0xf7, 0xfe, 0xff, 0x08, 0xf1, 0x04, 0x01, 0x51, 0x45, 0x0a, 0xd8,
  0x01, 0x35, 0x09, 0xf1, 0x10, 0x09, 0xb5, 0xf5, 0x80, 0x6f, 0xc7, 0xf8,
  0x0c, 0x04, 0xce, 0xd1, 0x03, 0xb0, 0xbd, 0xe8, 0xf0, 0x8f, 0x01, 0x98,
  0x02, 0x21, 0x03, 0xb0, 0xbd, 0xe8, 0xf0, 0x4f, 0xff, 0xf7, 0xfe, 0xbf,
  0x80, 0xb5, 0x82, 0xb0, 0x02, 0x46, 0x40, 0xf2, 0x00, 0x00, 0xc0, 0xf2,
  0x00, 0x00, 0x0d, 0xf1, 0x04, 0x0c, 0x43, 0x68, 0x90, 0x68, 0x9c, 0x45,
  0x22, 0xbf, 0xac, 0xeb, 0x03, 0x03, 0x12, 0x69, 0x93, 0x42, 0x04, 0xd2,
  0x0b, 0x21, 0xff, 0xf7, 0xfe, 0xff, 0x02, 0xb0, 0x80, 0xbd, 0x02, 0xb0,
  0xbd, 0xe8, 0x80, 0x40, 0xff, 0xe7, 0x2d, 0xe9, 0xf0, 0x4f, 0x89, 0xb0,
  0x01, 0x29, 0x05, 0x90, 0x08, 0x46, 0x03, 0x91, 0x75, 0xdb, 0x05, 0x99,
  0xd1, 0xf8, 0x78, 0x01, 0xd1, 0xf8, 0xb8, 0x41, 0x00, 0x21, 0x00, 0xf5,
  0x80, 0x6b, 0x00, 0xf5, 0x10, 0x50, 0x01, 0x90, 0x06, 0x94, 0xcd, 0xf8,
  0x08, 0xb0, 0x00, 0x22, 0x6f, 0xf0, 0x01, 0x09, 0x40, 0xf2, 0x0c, 0x4a,
  0x04, 0x91, 0xaa, 0xf1, 0x08, 0x00, 0xa0, 0x42, 0x98, 0xbf, 0xa2, 0x45,
  0x5e, 0xd8, 0xdb, 0xf8, 0x04, 0x70, 0xdb, 0xf8, 0x0c, 0x80, 0xdb, 0xf8,
  0x00, 0x50, 0x38, 0x46, 0xdb, 0xf8, 0x08, 0x40, 0x41, 0x46, 0x08, 0x92,
  0xff, 0xf7, 0xfe, 0xff, 0x4f, 0xf0, 0x7c, 0x51, 0xff, 0xf7, 0xfe, 0xff,
  0x07, 0x90, 0x21, 0x46, 0xcb, 0xf8, 0x0c, 0x00, 0x28, 0x46, 0xff, 0xf7,
  0xfe, 0xff, 0x4f, 0xf0, 0x7c, 0x51, 0xff, 0xf7, 0xfe, 0xff, 0x06, 0x46,
  0xcb, 0xf8, 0x08, 0x00, 0x38, 0x46, 0x41, 0x46, 0xff, 0xf7, 0xfe, 0xff,
  0x4f, 0xf0, 0x7c, 0x51, 0xff, 0xf7, 0xfe, 0xff, 0x21, 0x46, 0x07, 0x46,
  0xcb, 0xf8, 0x04, 0x00, 0x28, 0x46, 0x06, 0x9c, 0xff, 0xf7, 0xfe, 0xff,
  0x4f, 0xf0, 0x7c, 0x51, 0xff, 0xf7, 0xfe, 0xff, 0x39, 0x46, 0xcb, 0xf8,
  0x00, 0x00, 0xff, 0xf7, 0xfe, 0xff, 0x01, 0x46, 0x30, 0x46, 0xff, 0xf7,
  0xfe, 0xff, 0x01, 0x46, 0x07, 0x98, 0xff, 0xf7, 0xfe, 0xff, 0x01, 0x46,
  0x08, 0x98, 0xff, 0xf7, 0xfe, 0xff, 0x0a, 0xf1, 0x10, 0x0a, 0x0b, 0xf1,
  0x10, 0x0b, 0x09, 0xf1, 0x02, 0x09, 0x02, 0x46, 0x40, 0xf2, 0xfe, 0x30,
  0x81, 0x45, 0xaa, 0xd3, 0x01, 0x9d, 0x10, 0x46, 0x29, 0x68, 0xff, 0xf7,
  0xfe, 0xff, 0x04, 0x99, 0x28, 0x60, 0x03, 0x98, 0x01, 0x31, 0xdd, 0xf8,
  0x08, 0xb0, 0x81, 0x42, 0x97, 0xd1, 0x09, 0xb0, 0xbd, 0xe8, 0xf0, 0x8f,
  0x05, 0x98, 0x02, 0x21, 0x09, 0xb0, 0xbd, 0xe8, 0xf0, 0x4f, 0xff, 0xf7,
  0xfe, 0xbf, 0x80, 0xb5, 0x82, 0xb0, 0x40, 0xf2, 0x00, 0x01, 0x01, 0xaa,
  0xc0, 0xf2, 0x00, 0x01, 0x89, 0x68, 0x51, 0x1a, 0x24, 0xbf, 0x02, 0x69,
  0x91, 0x42, 0x06, 0xd2, 0x80, 0x68, 0x0b, 0x21, 0xff, 0xf7, 0xfe, 0xff,
  0x00, 0x20, 0x02, 0xb0, 0x80, 0xbd, 0x02, 0xb0, 0xbd, 0xe8, 0x80, 0x40,
  0xff, 0xe7, 0x80, 0x68, 0x4f, 0xf4, 0x10, 0x51, 0xd0, 0xf8, 0x78, 0x01,
  0x40, 0x58, 0x70, 0x47, 0x80, 0xb5, 0x82, 0xb0, 0x40, 0xf2, 0x00, 0x01,
  0x01, 0xaa, 0xc0, 0xf2, 0x00, 0x01, 0xc9, 0x68, 0x51, 0x1a, 0x24, 0xbf,
  0x02, 0x69, 0x91, 0x42, 0x06, 0xd2, 0x80, 0x68, 0x0b, 0x21, 0xff, 0xf7,
  0xfe, 0xff, 0x00, 0x20, 0x02, 0xb0, 0x80, 0xbd, 0x4f, 0xf4, 0x80, 0x60,
  0x02, 0xb0, 0x80, 0xbd, 0x03, 0x00, 0x00, 0x00, 0x40, 0x00, 0x00, 0x00,
  0x00, 0x00, 0x00, 0x00, 0xc0, 0x00, 0x00, 0x00, 0x06, 0x02, 0x00, 0x00,
  0x44, 0x02, 0x00, 0x00, 0x00, 0x00, 0x00, 0x00, 0x01, 0x00, 0x00, 0x00,
  0x02, 0x00, 0x00, 0x00, 0x03, 0x00, 0x00, 0x00, 0x04, 0x00, 0x00, 0x00,
  0x0d, 0x00, 0x00, 0x00, 0x00, 0x00, 0x00, 0x00, 0x00, 0x00, 0x00, 0x00,
  0x03, 0x00, 0x00, 0x00, 0x05, 0x00, 0x00, 0x00, 0x01, 0x00, 0x00, 0x00,
  0x01, 0x00, 0x00, 0x00, 0x04, 0x00, 0x00, 0x00, 0x61, 0x00, 0x00, 0x00,
  0x05, 0x00, 0x00, 0x00, 0x00, 0x00, 0x00, 0x00, 0x02, 0x00, 0x07, 0x00,
  0x6d, 0x65, 0x6d, 0x6f, 0x72, 0x79, 0x00, 0x00, 0x00, 0x00, 0x00, 0x00,
  0x00, 0x00, 0x0c, 0x00, 0x69, 0x6e, 0x69, 0x74, 0x5f, 0x62, 0x75, 0x66,
  0x66, 0x65, 0x72, 0x00, 0x01, 0x00, 0x00, 0x00, 0x00, 0x00, 0x06, 0x00,
  0x62, 0x65, 0x6e, 0x63, 0x68, 0x00, 0x00, 0x00, 0x02, 0x00, 0x00, 0x00,
  0x00, 0x00, 0x0d, 0x00, 0x67, 0x65, 0x74, 0x5f, 0x63, 0x68, 0x65, 0x63,
  0x6b, 0x73, 0x75, 0x6d, 0x00, 0x00, 0x00, 0x00, 0x03, 0x00, 0x00, 0x00,
  0x00, 0x00, 0x09, 0x00, 0x67, 0x65, 0x74, 0x5f, 0x6e, 0x66, 0x66, 0x74,
  0x00, 0x00, 0x00, 0x00, 0x05, 0x00, 0x00, 0x00, 0x9c, 0x02, 0x00, 0x00,
  0x07, 0x00, 0x00, 0x00, 0x00, 0x00, 0x00, 0x00, 0x0c, 0x00, 0x00, 0x00,
  0x20, 0x00, 0x00, 0x00, 0x3c, 0x00, 0x00, 0x00, 0x4c, 0x00, 0x00, 0x00,
  0x5c, 0x00, 0x00, 0x00, 0x6c, 0x00, 0x00, 0x00, 0x7c, 0x00, 0x00, 0x00,
  0x0a, 0x00, 0x2e, 0x72, 0x65, 0x6c, 0x2e, 0x74, 0x65, 0x78, 0x74, 0x00,
  0x11, 0x00, 0x2e, 0x61, 0x6f, 0x74, 0x5f, 0x73, 0x74, 0x61, 0x63, 0x6b,
  0x5f, 0x73, 0x69, 0x7a, 0x65, 0x73, 0x00, 0x00, 0x1a, 0x00, 0x61, 0x6f,
  0x74, 0x5f, 0x73, 0x65, 0x74, 0x5f, 0x65, 0x78, 0x63, 0x65, 0x70, 0x74,
  0x69, 0x6f, 0x6e, 0x5f, 0x77, 0x69, 0x74, 0x68, 0x5f, 0x69, 0x64, 0x00,
  0x0d, 0x00, 0x5f, 0x5f, 0x61, 0x65, 0x61, 0x62, 0x69, 0x5f, 0x75, 0x69,
  0x32, 0x66, 0x00, 0x00, 0x0d, 0x00, 0x5f, 0x5f, 0x61, 0x65, 0x61, 0x62,
  0x69, 0x5f, 0x66, 0x6d, 0x75, 0x6c, 0x00, 0x00, 0x0d, 0x00, 0x5f, 0x5f,
  0x61, 0x65, 0x61, 0x62, 0x69, 0x5f, 0x66, 0x73, 0x75, 0x62, 0x00, 0x00,
  0x0d, 0x00, 0x5f, 0x5f, 0x61, 0x65, 0x61, 0x62, 0x69, 0x5f, 0x66, 0x61,
  0x64, 0x64, 0x00, 0x00, 0x01, 0x00, 0x00, 0x00, 0x00, 0x00, 0x00, 0x00,
  0x1f, 0x00, 0x00, 0x00, 0x06, 0x00, 0x00, 0x00, 0x00, 0x00, 0x00, 0x00,
  0x2f, 0x00, 0x00, 0x00, 0x01, 0x00, 0x00, 0x00, 0x0a, 0x00, 0x00, 0x00,
  0x00, 0x00, 0x00, 0x00, 0x30, 0x00, 0x00, 0x00, 0x01, 0x00, 0x00, 0x00,
  0x22, 0x00, 0x00, 0x00, 0x00, 0x00, 0x00, 0x00, 0x0a, 0x00, 0x00, 0x00,
  0x02, 0x00, 0x00, 0x00, 0x50, 0x00, 0x00, 0x00, 0x00, 0x00, 0x00, 0x00,
  0x0a, 0x00, 0x00, 0x00, 0x03, 0x00, 0x00, 0x00, 0x72, 0x00, 0x00, 0x00,
  0x00, 0x00, 0x00, 0x00, 0x0a, 0x00, 0x00, 0x00, 0x03, 0x00, 0x00, 0x00,
  0x82, 0x00, 0x00, 0x00, 0x00, 0x00, 0x00, 0x00, 0x0a, 0x00, 0x00, 0x00,
  0x04, 0x00, 0x00, 0x00, 0x90, 0x00, 0x00, 0x00, 0x00, 0x00, 0x00, 0x00,
  0x0a, 0x00, 0x00, 0x00, 0x04, 0x00, 0x00, 0x00, 0xbc, 0x00, 0x00, 0x00,
  0x00, 0x00, 0x00, 0x00, 0x1e, 0x00, 0x00, 0x00, 0x02, 0x00, 0x00, 0x00,
  0xc6, 0x00, 0x00, 0x00, 0x00, 0x00, 0x00, 0x00, 0x2f, 0x00, 0x00, 0x00,
  0x01, 0x00, 0x00, 0x00, 0xca, 0x00, 0x00, 0x00, 0x00, 0x00, 0x00, 0x00,
  0x30, 0x00, 0x00, 0x00, 0x01, 0x00, 0x00, 0x00, 0xe6, 0x00, 0x00, 0x00,
  0x00, 0x00, 0x00, 0x00, 0x0a, 0x00, 0x00, 0x00, 0x02, 0x00, 0x00, 0x00,
  0x50, 0x01, 0x00, 0x00, 0x00, 0x00, 0x00, 0x00, 0x0a, 0x00, 0x00, 0x00,
  0x05, 0x00, 0x00, 0x00, 0x58, 0x01, 0x00, 0x00, 0x00, 0x00, 0x00, 0x00,
  0x0a, 0x00, 0x00, 0x00, 0x04, 0x00, 0x00, 0x00, 0x66, 0x01, 0x00, 0x00,
  0x00, 0x00, 0x00, 0x00, 0x0a, 0x00, 0x00, 0x00, 0x05, 0x00, 0x00, 0x00,
  0x6e, 0x01, 0x00, 0x00, 0x00, 0x00, 0x00, 0x00, 0x0a, 0x00, 0x00, 0x00,
  0x04, 0x00, 0x00, 0x00, 0x7c, 0x01, 0x00, 0x00, 0x00, 0x00, 0x00, 0x00,
  0x0a, 0x00, 0x00, 0x00, 0x06, 0x00, 0x00, 0x00, 0x84, 0x01, 0x00, 0x00,
  0x00, 0x00, 0x00, 0x00, 0x0a, 0x00, 0x00, 0x00, 0x04, 0x00, 0x00, 0x00,
  0x94, 0x01, 0x00, 0x00, 0x00, 0x00, 0x00, 0x00, 0x0a, 0x00, 0x00, 0x00,
  0x06, 0x00, 0x00, 0x00, 0x9c, 0x01, 0x00, 0x00, 0x00, 0x00, 0x00, 0x00,
  0x0a, 0x00, 0x00, 0x00, 0x04, 0x00, 0x00, 0x00, 0xa6, 0x01, 0x00, 0x00,
  0x00, 0x00, 0x00, 0x00, 0x0a, 0x00, 0x00, 0x00, 0x06, 0x00, 0x00, 0x00,
  0xae, 0x01, 0x00, 0x00, 0x00, 0x00, 0x00, 0x00, 0x0a, 0x00, 0x00, 0x00,
  0x06, 0x00, 0x00, 0x00, 0xb6, 0x01, 0x00, 0x00, 0x00, 0x00, 0x00, 0x00,
  0x0a, 0x00, 0x00, 0x00, 0x06, 0x00, 0x00, 0x00, 0xbe, 0x01, 0x00, 0x00,
  0x00, 0x00, 0x00, 0x00, 0x0a, 0x00, 0x00, 0x00, 0x06, 0x00, 0x00, 0x00,
  0xde, 0x01, 0x00, 0x00, 0x00, 0x00, 0x00, 0x00, 0x0a, 0x00, 0x00, 0x00,
  0x06, 0x00, 0x00, 0x00, 0x02, 0x02, 0x00, 0x00, 0x00, 0x00, 0x00, 0x00,
  0x1e, 0x00, 0x00, 0x00, 0x02, 0x00, 0x00, 0x00, 0x0a, 0x02, 0x00, 0x00,
  0x00, 0x00, 0x00, 0x00, 0x2f, 0x00, 0x00, 0x00, 0x01, 0x00, 0x00, 0x00,
  0x10, 0x02, 0x00, 0x00, 0x00, 0x00, 0x00, 0x00, 0x30, 0x00, 0x00, 0x00,
  0x01, 0x00, 0x00, 0x00, 0x24, 0x02, 0x00, 0x00, 0x00, 0x00, 0x00, 0x00,
  0x0a, 0x00, 0x00, 0x00, 0x02, 0x00, 0x00, 0x00, 0x48, 0x02, 0x00, 0x00,
  0x00, 0x00, 0x00, 0x00, 0x2f, 0x00, 0x00, 0x00, 0x01, 0x00, 0x00, 0x00,
  0x4e, 0x02, 0x00, 0x00, 0x00, 0x00, 0x00, 0x00, 0x30, 0x00, 0x00, 0x00,
  0x01, 0x00, 0x00, 0x00, 0x62, 0x02, 0x00, 0x00, 0x00, 0x00, 0x00, 0x00,
  0x0a, 0x00, 0x00, 0x00, 0x02, 0x00, 0x00, 0x00
};
unsigned int fft_bench_aot_len = 1772;
```
