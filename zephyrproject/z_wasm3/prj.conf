## prj.conf
```kconfig
CONFIG_GPIO=y
CONFIG_SERIAL=y
CONFIG_UART_CONSOLE=y
CONFIG_CONSOLE=y
CONFIG_PRINTK=y
CONFIG_RTT_CONSOLE=n
CONFIG_USB_DEVICE_STACK=n
CONFIG_LOG=n
CONFIG_CLOCK_CONTROL=y
CONFIG_CLOCK_CONTROL_STM32_CUBE=y
```

## src/main.c
```c
#include <zephyr/kernel.h>
#include <stm32f4xx.h>
#include "wasm3.h"
#include "toggle.wasm.h"

static uint32_t s;
m3ApiRawFunction(host_gpio_toggle) {
    
    s ^= 1u;
    if (s) GPIOA->BSRR = (1u << 5);
    else   GPIOA->BSRR = (1u << (5 + 16));
    m3ApiSuccess();
}

static inline void link_host(IM3Module mod) {
    m3_LinkRawFunction(mod, "env", "gpio_toggle", "v()", &host_gpio_toggle);
}

static void run_wasm_toggle_forever(void) {
    IM3Environment env = m3_NewEnvironment();
    if (!env) return;

    IM3Runtime rt = m3_NewRuntime(env, 8*1024, NULL);
    if (!rt) return;

    IM3Module mod = NULL;
    M3Result r = m3_ParseModule(env, &mod,
                     (const uint8_t*)toggle_wasm, toggle_wasm_len);
    if (r) return;

    r = m3_LoadModule(rt, mod);
    if (r) return;

    link_host(mod);

    IM3Function f = NULL;
    r = m3_FindFunction(&f, rt, "toggle_forever");
    if (r || !f) return;

    (void)m3_CallV(f);   // non ritorna finché la VM gira
}

static inline void gpio_pa5_init(void) {
    RCC->AHB1ENR |= RCC_AHB1ENR_GPIOAEN;
    GPIOA->MODER   = (GPIOA->MODER & ~(3u << (5*2))) | (1u << (5*2));
    GPIOA->OSPEEDR = (GPIOA->OSPEEDR & ~(3u << (5*2))) | (3u << (5*2));
}

void main(void) {
    gpio_pa5_init();
    run_wasm_toggle_forever();
    while (1) {
        /* se mai tornasse, non fare altro */
    }
}
```

## src/toggle.wasm.h
```c
unsigned char toggle_wasm[] = {
  0x00, 0x61, 0x73, 0x6d, 0x01, 0x00, 0x00, 0x00, 0x01, 0x04, 0x01, 0x60,
  0x00, 0x00, 0x02, 0x13, 0x01, 0x03, 0x65, 0x6e, 0x76, 0x0b, 0x67, 0x70,
  0x69, 0x6f, 0x5f, 0x74, 0x6f, 0x67, 0x67, 0x6c, 0x65, 0x00, 0x00, 0x03,
  0x02, 0x01, 0x00, 0x07, 0x12, 0x01, 0x0e, 0x74, 0x6f, 0x67, 0x67, 0x6c,
  0x65, 0x5f, 0x66, 0x6f, 0x72, 0x65, 0x76, 0x65, 0x72, 0x00, 0x01, 0x0a,
  0x0b, 0x01, 0x09, 0x00, 0x03, 0x40, 0x10, 0x00, 0x0c, 0x00, 0x0b, 0x0b
};
unsigned int toggle_wasm_len = 72;
```
